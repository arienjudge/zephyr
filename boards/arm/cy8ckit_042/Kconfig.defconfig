## boards/arm/cy8ckit_042/Kconfig.defconfig
```kconfig
# PSoC4 Pioneer Kit configuration

# Copyright (c) 2018 Cypress
# Copyright (c) 2020 ATL Electronics
# SPDX-License-Identifier: Apache-2.0

if BOARD_CY8CKIT_042_M0

config BOARD
	default "cy8ckit_042_m0" if BOARD_CY8CKIT_042_M0

endif   # BOARD_CY8CKIT_042_M0
```

## boards/arm/cy8ckit_044/Kconfig.board
```kconfig
# PSoC4 Pioneer Kit configuration

# Copyright (c) 2018 Cypress
# Copyright (c) 2020 ATL Electronics
# SPDX-License-Identifier: Apache-2.0

config BOARD_CY8CKIT_044_M0
	bool "PSoC4 Pioneer Kit [M0 CPU0]"
	depends on SOC_PART_NUMBER_CY8C4247AZI_M485
```

## boards/arm/cy8ckit_044/cy8ckit_044_m0_defconfig
```kconfig
#
# Copyright (c) 2018, Cypress
# Copyright (c) 2020, ATL Electronics
#
# SPDX-License-Identifier: Apache-2.0
#

CONFIG_SOC_SERIES_PSOC42=y
CONFIG_SOC_PSOC4_M0=y
CONFIG_SOC_PART_NUMBER_CY8C4247AZI_M485=y
CONFIG_BOARD_CY8CKIT_044_M0=y
```

## drivers/gpio/Kconfig.psoc4
```kconfig
# Copyright (c) 2020 ATL Electronics
# SPDX-License-Identifier: Apache-2.0

# Workaround for not being able to have commas in macro arguments
DT_COMPAT_CYPRESS_PSOC4_GPIO := cypress,psoc4-gpio

config GPIO_PSOC6
	bool "Cypress PSoC-4 GPIO driver"
	default y if $(dt_compat_enabled,$(DT_COMPAT_CYPRESS_PSOC4_GPIO))
	depends on SOC_FAMILY_PSOC4
	help
	  Enable support for the Cypress PSoC-4 GPIO controllers.
```

## drivers/serial/Kconfig.psoc4
```kconfig
# Cypress SCB[UART] configuration

# Copyright (c) 2018 Cypress
# Copyright (c) 2020 ATL Electronics
# SPDX-License-Identifier: Apache-2.0

config UART_PSOC4
	bool "PSoC-4 MCU SCB serial driver"
	depends on SOC_FAMILY_PSOC4
	select SERIAL_HAS_DRIVER
	select SERIAL_SUPPORT_INTERRUPT
	select USE_INFINEON_UART
	help
	  This option enables the SCB[UART] driver for PSoC-4 SoC family.
```

## drivers/spi/Kconfig.psoc4
```kconfig
# Cypress SCB[SPI] configuration

# Copyright (c) 2021 ATL Electronics
# SPDX-License-Identifier: Apache-2.0

config SPI_PSOC4
	bool "PSoC-4 MCU SCB spi driver"
	depends on SOC_FAMILY_PSOC4
	select USE_INFINEON_SPI
	help
	  This option enables the SCB[SPI] driver for PSoC-4 SoC family.
```

## soc/arm/cypress/Kconfig
```kconfig
# Copyright (c) 2018, Cypress
# Copyright (c) 2020, ATL Electronics
# SPDX-License-Identifier: Apache-2.0

choice
	prompt "Cypress PSoC6 MCU Selection"
	depends on SOC_SERIES_PSOC62 || \
		   SOC_SERIES_PSOC63

config SOC_PSOC6_M0
	bool "SOC_PSOC6_M0"
	select CPU_CORTEX_M0PLUS
	select CPU_CORTEX_M_HAS_SYSTICK
	select CPU_CORTEX_M_HAS_VTOR

config SOC_PSOC6_M4
	bool "SOC_PSOC6_M4"
	select CPU_CORTEX_M4
	select CPU_CORTEX_M_HAS_DWT
	select CPU_CORTEX_M_HAS_SYSTICK

endchoice

choice
	prompt "Cypress PSoC4 MCU Selection"
	depends on SOC_SERIES_PSOC42

config SOC_PSOC4_M0
	bool "SOC_PSOC4_M0"
	select CPU_CORTEX_M0
	select CPU_CORTEX_M_HAS_SYSTICK

config SOC_PSOC4_M0PLUS
	bool "SOC_PSOC4_M0PLUS"
	select CPU_CORTEX_M0PLUS
	select CPU_CORTEX_M_HAS_SYSTICK
	select CPU_CORTEX_M_HAS_VTOR

endchoice

config SOC_PSOC6_M0_ENABLES_M4
	bool "Dual-core support [activate Cortex-M4]"
	depends on SOC_PSOC6_M0
	help
	  Cortex-M0 CPU should boot Cortex-M4

config SOC_FAMILY_PSOC6
	bool

if SOC_FAMILY_PSOC6

config SOC_FAMILY
	string
	default "cypress"

source "soc/arm/cypress/psoc6/Kconfig.soc"

endif # SOC_FAMILY_PSOC6


config SOC_FAMILY_PSOC4
	bool

if SOC_FAMILY_PSOC4

config SOC_FAMILY
	string
	default "cypress"

source "soc/arm/cypress/psoc4/Kconfig.soc"

endif # SOC_FAMILY_PSOC4
```

## soc/arm/cypress/psoc4/Kconfig.defconfig.series
```kconfig
# Cypress Semiconductor PSoC6 series configuration options

# Copyright (c) 2018, Cypress
# Copyright (c) 2020, ATL Electronics
# SPDX-License-Identifier: Apache-2.0

if SOC_SERIES_PSOC42

config SOC_SERIES
	default "psoc4"

config SOC_PART_NUMBER
	default "CY8C4247AZI_M485" if SOC_PART_NUMBER_CY8C4247AZI_M485

config SYS_CLOCK_HW_CYCLES_PER_SEC
	default 48000000

config SOC
	default "psoc4_m0"

config NUM_IRQS
	default 32

config UART_PSOC4
	default y
	depends on SERIAL

endif   # SOC_SERIES_PSOC42
```

## soc/arm/cypress/psoc4/Kconfig.series
```kconfig
# Cypress PSoC6 MCU line

# Copyright (c) 2018, Cypress Semiconductor
# Copyright (c) 2020, ATL Electronics
# SPDX-License-Identifier: Apache-2.0

config SOC_SERIES_PSOC42
	bool "Cypress PSoC4 series MCU - Standard"
	select ARM
	select SOC_FAMILY_PSOC4
	select HAS_CYPRESS_DRIVERS
	help
	  Enable support for Cypress PSoC4 MCU series
```

## soc/arm/cypress/psoc4/Kconfig.soc
```kconfig
# Cypress PSOC6 MCU line

# Copyright (c) 2018, Cypress
# Copyright (c) 2020, ATL Electronics
# SPDX-License-Identifier: Apache-2.0

choice
	prompt "Cypress PSoC4 MCU Selection"
	depends on SOC_SERIES_PSOC42

config SOC_PART_NUMBER_CY8C4247AZI_M485
	bool "CY8C4247AZI_M485"
	depends on SOC_SERIES_PSOC42

endchoice
```
